## meta-dream/conf/machine/dm900.conf
```bitbake
#@TYPE: Machine
#@NAME: Dreambox DM900
#@DESCRIPTION: Machine configuration for the Dreambox DM900

MACHINE_FEATURES += "modem kernelwifi dvb-c blindscan-dvbc hdmicec recovery ci dvd usbconsole colorlcd390"

CHIPSET = "bcm7252s"
SOC_FAMILY = "bcm7252s"

PREFERRED_VERSION_tzdata = "2017b"
PREFERRED_VERSION_sdparm = "1.07"

require conf/machine/include/dreambox-arm.inc

PREFERRED_PROVIDER_virtual/egl ?= "libvc5dream"
PREFERRED_PROVIDER_virtual/libgles1 ?= "libvc5dream"
PREFERRED_PROVIDER_virtual/libgles2 ?= "libvc5dream"
```

## meta-dreambox/conf/machine/dm900.conf
```bitbake
#@TYPE: Machine
#@NAME: Dreambox DM900
#@DESCRIPTION: Machine configuration for the Dreambox DM900

MACHINE_FEATURES += "modem kernelwifi dvb-c blindscan-dvbc hdmicec recovery ci dvd usbconsole colorlcd390"

CHIPSET = "bcm7252s"
SOC_FAMILY = "bcm7252s"

PREFERRED_VERSION_libvpx = "1.6.1"
PREFERRED_VERSION_nfs-utils = "2.3.3"

require conf/machine/include/dreambox-arm.inc

PREFERRED_PROVIDER_virtual/egl ?= "libvc5dream"
PREFERRED_PROVIDER_virtual/libgles1 ?= "libvc5dream"
PREFERRED_PROVIDER_virtual/libgles2 ?= "libvc5dream"
```

## meta-dreambox/conf/machine/dm920.conf
```bitbake
#@TYPE: Machine
#@NAME: Dreambox DM920
#@DESCRIPTION: Machine configuration for the Dreambox DM920

MACHINE_FEATURES += "modem kernelwifi dvb-c blindscan-dvbc hdmicec recovery ci dvd usbconsole colorlcd400"

CHIPSET = "bcm7252s"
SOC_FAMILY = "bcm7252s"
PREFERRED_VERSION_libvpx = "1.6.1"
PREFERRED_VERSION_nfs-utils = "2.3.3"

require conf/machine/include/dreambox-arm.inc

PREFERRED_PROVIDER_virtual/egl ?= "libvc5dream"
PREFERRED_PROVIDER_virtual/libgles1 ?= "libvc5dream"
PREFERRED_PROVIDER_virtual/libgles2 ?= "libvc5dream"
```
